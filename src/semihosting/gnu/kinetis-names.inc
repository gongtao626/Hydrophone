/* ISR names for kinetis
 *
 * Version: Sourcery G++ 2010.09-66
 * Support: https://support.codesourcery.com/GNUToolchain/
 *
 * Copyright (c) 2007, 2008, 2009, 2010 CodeSourcery, Inc.
 *
 * The authors hereby grant permission to use, copy, modify, distribute,
 * and license this software and its documentation for any purpose, provided
 * that existing copyright notices are retained in all copies and that this
 * notice is included verbatim in any distributions.  No written agreement,
 * license, or royalty fee is required for any of the authorized uses.
 * Modifications to this software may be copyrighted by their authors
 * and need not follow the licensing terms described here, provided that
 * the new terms are clearly indicated on the first page of each file where
 * they apply.
 */
EXTERN (__cs3_stack)
EXTERN (__cs3_reset)
EXTERN (__cs3_isr_nmi)
EXTERN (__cs3_isr_hard_fault)
EXTERN (__cs3_isr_mpu_fault)
EXTERN (__cs3_isr_bus_fault)
EXTERN (__cs3_isr_usage_fault)
EXTERN (__cs3_isr_reserved_7)
EXTERN (__cs3_isr_reserved_8)
EXTERN (__cs3_isr_reserved_9)
EXTERN (__cs3_isr_reserved_10)
EXTERN (__cs3_isr_svcall)
EXTERN (__cs3_isr_debug)
EXTERN (__cs3_isr_reserved_13)
EXTERN (__cs3_isr_pendsv)
EXTERN (__cs3_isr_systick)
EXTERN (__cs3_isr_dma0)
EXTERN (__cs3_isr_dma1)
EXTERN (__cs3_isr_dma2)
EXTERN (__cs3_isr_dma3)
EXTERN (__cs3_isr_dma4)
EXTERN (__cs3_isr_dma5)
EXTERN (__cs3_isr_dma6)
EXTERN (__cs3_isr_dma7)
EXTERN (__cs3_isr_dma8)
EXTERN (__cs3_isr_dma9)
EXTERN (__cs3_isr_dma10)
EXTERN (__cs3_isr_dma11)
EXTERN (__cs3_isr_dma12)
EXTERN (__cs3_isr_dma13)
EXTERN (__cs3_isr_dma14)
EXTERN (__cs3_isr_dma15)
EXTERN (__cs3_isr_dma_error)
EXTERN (__cs3_isr_mcm)
EXTERN (__cs3_isr_flash_command_complete)
EXTERN (__cs3_isr_flash_read_collision)
EXTERN (__cs3_isr_mode_controller)
EXTERN (__cs3_isr_llwu)
EXTERN (__cs3_isr_wdog)
EXTERN (__cs3_isr_rngb)
EXTERN (__cs3_isr_i2c0)
EXTERN (__cs3_isr_i2c1)
EXTERN (__cs3_isr_spi0)
EXTERN (__cs3_isr_spi1)
EXTERN (__cs3_isr_spi2)
EXTERN (__cs3_isr_can0_ored_message_buffer)
EXTERN (__cs3_isr_can0_buf_off)
EXTERN (__cs3_isr_can0_error)
EXTERN (__cs3_isr_can0_transmit_warning)
EXTERN (__cs3_isr_can0_receive_warning)
EXTERN (__cs3_isr_can0_wake_up)
EXTERN (__cs3_isr_can0_imeu)
EXTERN (__cs3_isr_can0_lost_receive)
EXTERN (__cs3_isr_can1_ored_message_buffer)
EXTERN (__cs3_isr_can1_buf_off)
EXTERN (__cs3_isr_can1_error)
EXTERN (__cs3_isr_can1_transmit_warning)
EXTERN (__cs3_isr_can1_receive_warning)
EXTERN (__cs3_isr_can1_wake_up)
EXTERN (__cs3_isr_can1_imeu)
EXTERN (__cs3_isr_can1_lost_receive)
EXTERN (__cs3_isr_uart0_status_sources)
EXTERN (__cs3_isr_uart0_error_sources)
EXTERN (__cs3_isr_uart1_status_sources)
EXTERN (__cs3_isr_uart1_error_sources)
EXTERN (__cs3_isr_uart2_status_sources)
EXTERN (__cs3_isr_uart2_error_sources)
EXTERN (__cs3_isr_uart3_status_sources)
EXTERN (__cs3_isr_uart3_error_sources)
EXTERN (__cs3_isr_uart4_status_sources)
EXTERN (__cs3_isr_uart4_error_sources)
EXTERN (__cs3_isr_uart5_status_sources)
EXTERN (__cs3_isr_uart5_error_sources)
EXTERN (__cs3_isr_adc0)
EXTERN (__cs3_isr_adc1)
EXTERN (__cs3_isr_cmp0)
EXTERN (__cs3_isr_cmp1)
EXTERN (__cs3_isr_cmp2)
EXTERN (__cs3_isr_ftm0)
EXTERN (__cs3_isr_ftm1)
EXTERN (__cs3_isr_ftm2)
EXTERN (__cs3_isr_cmt)
EXTERN (__cs3_isr_rtc)
EXTERN (__cs3_isr_reserved_83)
EXTERN (__cs3_isr_pit0)
EXTERN (__cs3_isr_pit1)
EXTERN (__cs3_isr_pit2)
EXTERN (__cs3_isr_pit3)
EXTERN (__cs3_isr_pdb)
EXTERN (__cs3_isr_usb_otg)
EXTERN (__cs3_isr_usb_charger_detect)
EXTERN (__cs3_isr_ethernet_mac_timer)
EXTERN (__cs3_isr_ethernet_mac_transmit)
EXTERN (__cs3_isr_ethernet_mac_receive)
EXTERN (__cs3_isr_ethernet_mac_error)
EXTERN (__cs3_isr_i2s)
EXTERN (__cs3_isr_sdhc)
EXTERN (__cs3_isr_dac0)
EXTERN (__cs3_isr_dac1)
EXTERN (__cs3_isr_tsi)
EXTERN (__cs3_isr_mcg)
EXTERN (__cs3_isr_low_power_timer)
EXTERN (__cs3_isr_reserved_102)
EXTERN (__cs3_isr_port_control_module_a)
EXTERN (__cs3_isr_port_control_module_b)
EXTERN (__cs3_isr_port_control_module_c)
EXTERN (__cs3_isr_port_control_module_d)
EXTERN (__cs3_isr_port_control_module_e)
